## arch/arm64/hotplug/Kconfig
```kconfig
config MSM_HOTPLUG
	bool "MSM hotplug by [Fluxi]"
	depends on HOTPLUG_CPU
	default n
	help
	  The MSM hotplug driver controls on-/offlining of additional cores based on current cpu load.

config ALUCARD_CONTROL
	bool "Alucard"
	depends on HOTPLUG_CPU && SMP
	help
	  Known for being battery friendly. Developed by Alucard_24@XDA
```
